## boards/shields/macropad15/Kconfig.defconfig
```kconfig
if SHIELD_MACROPAD15

config ZMK_KEYBOARD_NAME
	default "Macropad15"

# Encoder EC11 (3 nút xoay)
config EC11
	default y

# OLED SSD1306 (I2C)
if ZMK_DISPLAY

config I2C
	default y

config SSD1306
	default y

endif # ZMK_DISPLAY

if LVGL

config LV_Z_VDB_SIZE
	default 64

config LV_Z_DPI
	default 148

config LV_Z_BITS_PER_PIXEL
	default 1

choice LV_COLOR_DEPTH
	default LV_COLOR_DEPTH_1
endchoice

endif # LVGL

endif
```
